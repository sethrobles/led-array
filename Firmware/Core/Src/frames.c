/*
 * frames.c
 *
 *  Created on: Dec 6, 2025
 *      Author: sethrobles
 */

#include "main.h"       // for uint32_t, etc.
#include "led_array.h"  // for writeFrame(...) prototype
#include <string.h>     // for memset
#include <stdint.h>



// Used in the sprite animations
#define HEART_SIZE 8
#define SNOW_SIZE 8
#define SPRITE_SIZE 8
#define MAX_SPRITES 5



static void clearFrame(uint8_t frame[32][32])
{
    memset(frame, 0, 32 * 32 * sizeof(uint8_t));
}

static void variableDelay(uint32_t baseDelay, uint32_t filled, uint32_t total)
{
    // Delay shrinks as `filled` grows.
    // max ~ baseDelay, min = 1 iteration.
    uint32_t loops = (baseDelay * (total - filled)) / total;
    if (loops < 1)
        loops = 1;

    for (volatile uint32_t d = 0; d < loops; ++d)
    {
        __NOP();  // optional; keeps compiler from optimizing loop away
    }
}


// A pixel that moves around the border's edge in a spiral pattern
void animateBorderDot(uint32_t baseDelayMs)
{
    const int N = 32;
    static uint8_t frame[32][32];

    clearFrame(frame);

    int top    = 0;
    int bottom = N - 1;
    int left   = 0;
    int right  = N - 1;

    uint32_t filled      = 0;
    const uint32_t total = (uint32_t)N * (uint32_t)N;

    while (top <= bottom && left <= right && filled < total)
    {
        int row, col;

        // 1) Go right across the top row
        for (col = left; col <= right && filled < total; ++col)
        {
            row = top;
            frame[row][col] = 1;
            ++filled;

            writeFrame(frame);
            variableDelay(baseDelayMs, filled, total);
        }
        ++top;

        // 2) Go down the right column
        for (row = top; row <= bottom && filled < total; ++row)
        {
            col = right;
            frame[row][col] = 1;
            ++filled;

            writeFrame(frame);
            variableDelay(baseDelayMs, filled, total);
        }
        --right;

        // 3) Go left across the bottom row
        if (top <= bottom)
        {
            for (col = right; col >= left && filled < total; --col)
            {
                row = bottom;
                frame[row][col] = 1;
                ++filled;

                writeFrame(frame);
                variableDelay(baseDelayMs, filled, total);
            }
            --bottom;
        }

        // 4) Go up the left column
        if (left <= right)
        {
            for (row = bottom; row >= top && filled < total; --row)
            {
                col = left;
                frame[row][col] = 1;
                ++filled;

                writeFrame(frame);
                variableDelay(baseDelayMs, filled, total);
            }
            ++left;
        }
    }

    // Done: full spiral drawn, function returns so you can run other animations.
}


static void borderIndexToCoord(int idx, int N, int *r, int *c)
{
    const int perim = 4 * N - 4;
    idx %= perim;
    if (idx < 0) idx += perim;

    if (idx < N) {
        // Top edge: (0, 0) -> (0, N-1)
        *r = 0;
        *c = idx;
        return;
    }
    idx -= N;

    if (idx < N - 1) {
        // Right edge: (1, N-1) -> (N-1, N-1)
        *r = 1 + idx;
        *c = N - 1;
        return;
    }
    idx -= (N - 1);

    if (idx < N - 1) {
        // Bottom edge: (N-1, N-2) -> (N-1, 0)
        *r = N - 1;
        *c = (N - 2) - idx;
        return;
    }
    idx -= (N - 1);

    // Left edge: (N-2, 0) -> (1, 0)
    *r = (N - 2) - idx;
    *c = 0;
}



// Four dots move along the border from each corner to its opposite corner.
void animateCornersAroundEdges(uint32_t baseDelayMs)
{
    const int N = 32;
    const int perimeter = 4 * N - 4;         // 124 for 32x32
    const int halfPerimeter = perimeter; // 62 for 32x32

    static uint8_t frame[32][32];

    // Starting indices on the perimeter for the 4 corners (clockwise)
    const int startIdx[4] = {
        0,          // top-left  (0, 0)
        N - 1,      // top-right (0, N-1)
        2 * N - 2,  // bottom-right (N-1, N-1)
        3 * N - 3   // bottom-left  (N-1, 0)
    };

    // We move each corner dot half the perimeter so it reaches its opposite corner.
    for (int step = 0; step <= halfPerimeter; ++step)
    {
        clearFrame(frame);

        for (int i = 0; i < 4; ++i)
        {
            int idx = startIdx[i] + step;  // no wrap; we stop at opposite corner

            int r, c;
            borderIndexToCoord(idx, N, &r, &c);
            frame[r][c] = 1;
        }

        writeFrame(frame);

        // Simple fixed delay; swap this for variableDelay(...) if you want speed-up
        HAL_Delay(baseDelayMs);
        // or:
        // variableDelay(baseDelayMs, (uint32_t)(step + 1), (uint32_t)(halfPerimeter + 1));
    }

    // Done: all four have reached their opposite corners.
}



// Four-dot diagonal animation: start as 2x2 in center, move out to corners.
void animateDiagonalDot(uint32_t baseDelayMs)
{
    const int N = 32;              // assumes even; works generically for even N
    static uint8_t frame[32][32];

    const int mid0 = (N / 2) - 1;  // e.g., 15 for 32x32
    const int mid1 = (N / 2);      // e.g., 16 for 32x32

    // Number of steps to go from center block to the corners
    const int maxSteps = mid0;     // 15 for 32x32 → 16 frames (0..15)

    for (int s = 0; s <= maxSteps; ++s)
    {
//        clearFrame(frame);

        // Compute positions for this step
        int tl_r = mid0 - s;
        int tl_c = mid0 - s;

        int tr_r = mid0 - s;
        int tr_c = mid1 + s;

        int bl_r = mid1 + s;
        int bl_c = mid0 - s;

        int br_r = mid1 + s;
        int br_c = mid1 + s;

        // Set the four dots
        frame[tl_r][tl_c] = 1; // top-left
        frame[tr_r][tr_c] = 1; // top-right
        frame[bl_r][bl_c] = 1; // bottom-left
        frame[br_r][br_c] = 1; // bottom-right

        writeFrame(frame);

        // If you want constant delay, use HAL_Delay(baseDelay) instead
        variableDelay(baseDelayMs, (uint32_t)(s + 1), (uint32_t)(maxSteps + 1));
    }

    // Done; returns so you can chain to another animation if you want.
}


// SPrite animations


// 8x8 heart bitmap (1 = LED on)
static const uint8_t heart8[HEART_SIZE][HEART_SIZE] = {
    {0,1,1,0,0,1,1,0},
    {1,1,1,1,1,1,1,1},
    {1,1,1,1,1,1,1,1},
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    {0,0,0,0,0,0,0,0}
};


static const uint8_t snowflake8[SNOW_SIZE][SNOW_SIZE] = {
    {0, 0, 1, 0, 0, 1, 0, 0},
    {0, 1, 0, 1, 1, 0, 1, 0},
    {1, 0, 0, 1, 1, 0, 0, 1},
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    {0, 0, 1, 0, 0, 1, 0, 0}
};

typedef struct {
    int row;      // top row of heart
    int col;      // left col of heart
    uint8_t active;
} SpriteBubble;

typedef enum {
    SPRITE_HEART = 0,
    SPRITE_SNOWFLAKE = 1
} SpriteType;


static SpriteBubble bubbles[MAX_SPRITES];

// tiny pseudo-random generator (no libc rand needed)
static uint16_t hb_lfsr = 0xACE1u;
static uint16_t hb_rand16(void)
{
    hb_lfsr ^= hb_lfsr << 7;
    hb_lfsr ^= hb_lfsr >> 9;
    hb_lfsr ^= hb_lfsr << 8;
    return hb_lfsr;
}



// Draw a single sprite into the frame with bounds checks
static void drawSprite(uint8_t frame[32][32], const uint8_t sprite[8][8], int top, int left)
{
    for (int r = 0; r < SPRITE_SIZE; ++r)
    {
        int fr = top + r;
        if (fr < 0 || fr >= 32) continue;

        for (int c = 0; c < SPRITE_SIZE; ++c)
        {
            int fc = left + c;
            if (fc < 0 || fc >= 32) continue;

            if (sprite[r][c])
            {
                frame[fr][fc] = 1;
            }
        }
    }
}



// Main heart-bubble animation.
// totalSteps: how long to run (e.g. 600)
// baseDelayMs: delay per frame (e.g. 40)
void animateSpriteBubbles(SpriteType sprite, uint32_t totalSteps, uint32_t baseDelayMs)
{
    static uint8_t frame[32][32];
    const uint8_t (*sprite8)[8] = heart8; // pointer to 8-wide rows

    if (sprite == SPRITE_SNOWFLAKE) sprite8 = snowflake8;

    // Initialize bubbles as inactive
    for (int i = 0; i < MAX_SPRITES; ++i)
    {
        bubbles[i].active = 0;
    }

    for (uint32_t step = 0; step < totalSteps; ++step)
    {
        clearFrame(frame);

        // Move existing bubbles up
        for (int i = 0; i < MAX_SPRITES; ++i)
        {
            if (!bubbles[i].active) continue;

            // Move up
            bubbles[i].row--;

            // If heart fully off the top, deactivate
            if (bubbles[i].row < -SPRITE_SIZE)
            {
                bubbles[i].active = 0;
            }
            else
            {
            	drawSprite(frame, sprite8, bubbles[i].row, bubbles[i].col);
            }
        }

        // Periodically spawn a new bubble at the bottom
        // Tune the modulus (e.g. 6, 8, 10) for density
        if ((step % 8) == 0)
        {
            // Find an inactive slot
            for (int i = 0; i < MAX_SPRITES; ++i)
            {
                if (!bubbles[i].active)
                {
                    bubbles[i].active = 1;
                    bubbles[i].row    = 32;   // start just below visible area

                    // random column so the heart fits in 32x32
                    int maxCol = 32 - SPRITE_SIZE;  // 24 for 32x32
                    bubbles[i].col = hb_rand16() % (maxCol + 1);

                    break; // spawn only one this frame
                }
            }
        }
        writeFrame(frame);
    }
    writeFrame(frame);
}






#define FW_PANEL_SIZE 32

// ---------------- RNG for random x / height ----------------
#ifndef FIREWORKS_RNG
static uint16_t fw_lfsr = 0xC0DEu;
static uint16_t fw_rand16(void)
{
    // Simple xorshift-ish LFSR, fine for visual randomness
    fw_lfsr ^= fw_lfsr << 7;
    fw_lfsr ^= fw_lfsr >> 9;
    fw_lfsr ^= fw_lfsr << 8;
    return fw_lfsr;
}
#define FIREWORKS_RNG 1
#endif

// ---------------- Small busy-wait delay ----------------
static void fw_busyDelay(uint32_t loops)
{
    for (volatile uint32_t i = 0; i < loops; ++i)
    {
        // no-op, just burn cycles
    }
}

// ---------------- Explosion drawing helper ----------------
// 8 directions: N, NE, E, SE, S, SW, W, NW
static const int8_t fw_dirX[8] = {  0,  1,  1,  1,  0, -1, -1, -1 };
static const int8_t fw_dirY[8] = { -1, -1,  0,  1,  1,  1,  0, -1 };

static void fw_drawExplosion(uint8_t frame[FW_PANEL_SIZE][FW_PANEL_SIZE],
                             int cx, int cy, int radius)
{
    // Optionally keep the center bright in early frames
    if (radius <= 2)
    {
        if (cx >= 0 && cx < FW_PANEL_SIZE &&
            cy >= 0 && cy < FW_PANEL_SIZE)
        {
            frame[cy][cx] = 1;
        }
    }

    // Draw each ray at distance "radius" from the center
    for (int i = 0; i < 8; ++i)
    {
        int x = cx + fw_dirX[i] * radius;
        int y = cy + fw_dirY[i] * radius;

        if (x >= 0 && x < FW_PANEL_SIZE &&
            y >= 0 && y < FW_PANEL_SIZE)
        {
            frame[y][x] = 1;
        }
    }
}

// ---------------- Single firework animation ----------------
void animateSingleFirework(uint32_t baseDelayLoops)
{
    static uint8_t frame[FW_PANEL_SIZE][FW_PANEL_SIZE];

    // Random horizontal launch position, avoid extreme edges a bit
    int minX = 4;
    int maxX = FW_PANEL_SIZE - 4;   // 28 for 32x32
    int launchX = minX + (fw_rand16() % (maxX - minX + 1));

    // Random explosion height (higher up but not too high)
    int minHeight = 8;
    int maxHeight = FW_PANEL_SIZE / 2;  // e.g. 16
    int targetY   = maxHeight - (fw_rand16() % (maxHeight - minHeight + 1));
    // targetY is where we explode (smaller row index = higher)

    // -------- 1) Rocket ascent --------
    for (int y = FW_PANEL_SIZE - 1; y >= targetY; --y)
    {
        clearFrame(frame);

        // Rocket head
        frame[y][launchX] = 1;

        // Small tail behind it
        if (y + 1 < FW_PANEL_SIZE) frame[y + 1][launchX] = 1;
        if (y + 2 < FW_PANEL_SIZE) frame[y + 2][launchX] = 1;

        writeFrame(frame);
        fw_busyDelay(baseDelayLoops);
    }

    // Explosion center
    int cx = launchX;
    int cy = targetY;

    // -------- 2) Explosion expansion --------
    int maxRadius = 10;  // tweak for bigger/smaller bursts
    for (int r = 1; r <= maxRadius; ++r)
    {
        clearFrame(frame);

        fw_drawExplosion(frame, cx, cy, r);

        writeFrame(frame);
        fw_busyDelay(baseDelayLoops);
    }

    // -------- 3) Quick fade (optional) --------
    for (int fade = 0; fade < 3; ++fade)
    {
        clearFrame(frame);
        writeFrame(frame);
        fw_busyDelay(baseDelayLoops / 2);

        // Brief re-draw of last explosion radius for a flicker-y fade
        if (fade < 2)
        {
            clearFrame(frame);
            fw_drawExplosion(frame, cx, cy, maxRadius - fade);
            writeFrame(frame);
            fw_busyDelay(baseDelayLoops / 2);
        }
    }
}

// ---------------- Multiple fireworks in a row ----------------
// numFireworks: how many bursts to run
void animateFireworks(uint32_t numFireworks, uint32_t baseDelayLoops)
{
    for (uint32_t i = 0; i < numFireworks; ++i)
    {
        animateSingleFirework(baseDelayLoops);

        // Small pause between fireworks
        fw_busyDelay(baseDelayLoops * 200);
    }
}


// All the frames




// Defining Letter Frames

const uint8_t aFrame[32][32] = {
    {0,0,0,0,0,0,0,0,0,0,0,0,0,0,0,0,0,0,0,0,0,0,0,0,0,0,0,0,0,0,0,0},
    {0,0,0,0,0,0,0,0,0,0,0,0,0,0,0,0,0,0,0,0,0,0,0,0,0,0,0,0,0,0,0,0},
    {0,0,0,0,0,0,0,0,0,0,0,0,0,0,0,0,0,0,0,0,0,0,0,0,0,0,0,0,0,0,0,0},
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    {0,0,0,0,0,0,0,0,0,0,0,0,0,0,0,0,0,0,0,0,0,0,0,0,0,0,0,0,0,0,0,0}
};

const uint8_t iFrame[32][32] = {
    {0,0,0,0,0,0,0,0,0,0,0,0,0,0,0,0,0,0,0,0,0,0,0,0,0,0,0,0,0,0,0,0},
    {0,0,0,0,0,0,0,0,0,0,0,0,0,0,0,0,0,0,0,0,0,0,0,0,0,0,0,0,0,0,0,0},
    {0,0,0,0,0,0,0,0,0,0,0,0,0,0,0,0,0,0,0,0,0,0,0,0,0,0,0,0,0,0,0,0},
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    {0,0,0,0,0,0,0,0,0,0,0,0,0,0,0,0,0,0,0,0,0,0,0,0,0,0,0,0,0,0,0,0}
};

const uint8_t oFrame[32][32] = {
    {0,0,0,0,0,0,0,0,0,0,0,0,0,0,0,0,0,0,0,0,0,0,0,0,0,0,0,0,0,0,0,0},
    {0,0,0,0,0,0,0,0,0,0,0,0,0,0,0,0,0,0,0,0,0,0,0,0,0,0,0,0,0,0,0,0},
    {0,0,0,0,0,0,0,0,0,0,0,0,0,0,0,0,0,0,0,0,0,0,0,0,0,0,0,0,0,0,0,0},
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    {0,0,0,0,0,0,0,0,0,0,0,0,0,0,0,0,0,0,0,0,0,0,0,0,0,0,0,0,0,0,0,0}
};

const uint8_t uFrame[32][32] = {
    {0,0,0,0,0,0,0,0,0,0,0,0,0,0,0,0,0,0,0,0,0,0,0,0,0,0,0,0,0,0,0,0},
    {0,0,0,0,0,0,0,0,0,0,0,0,0,0,0,0,0,0,0,0,0,0,0,0,0,0,0,0,0,0,0,0},
    {0,0,0,0,0,0,0,0,0,0,0,0,0,0,0,0,0,0,0,0,0,0,0,0,0,0,0,0,0,0,0,0},
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    {0,0,0,0,0,0,0,0,0,0,0,0,0,0,0,0,0,0,0,0,0,0,0,0,0,0,0,0,0,0,0,0}
};

const uint8_t vFrame[32][32] = {
    {0,0,0,0,0,0,0,0,0,0,0,0,0,0,0,0,0,0,0,0,0,0,0,0,0,0,0,0,0,0,0,0},
    {0,0,0,0,0,0,0,0,0,0,0,0,0,0,0,0,0,0,0,0,0,0,0,0,0,0,0,0,0,0,0,0},
    {0,0,0,0,0,0,0,0,0,0,0,0,0,0,0,0,0,0,0,0,0,0,0,0,0,0,0,0,0,0,0,0},
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    {0,0,0,0,0,0,0,0,0,0,0,0,0,1,1,1,0,0,0,0,0,0,0,0,0,0,0,0,0,0,0,0},
    // --- THE POINT ---
    {0,0,0,0,0,0,0,0,0,0,0,0,0,0,1,1,0,0,0,0,0,0,0,0,0,0,0,0,0,0,0,0},
    {0,0,0,0,0,0,0,0,0,0,0,0,0,0,1,1,0,0,0,0,0,0,0,0,0,0,0,0,0,0,0,0},
    // --- BOTTOM PADDING ---
    {0,0,0,0,0,0,0,0,0,0,0,0,0,0,0,0,0,0,0,0,0,0,0,0,0,0,0,0,0,0,0,0},
    {0,0,0,0,0,0,0,0,0,0,0,0,0,0,0,0,0,0,0,0,0,0,0,0,0,0,0,0,0,0,0,0},
    {0,0,0,0,0,0,0,0,0,0,0,0,0,0,0,0,0,0,0,0,0,0,0,0,0,0,0,0,0,0,0,0}
};



const uint8_t yFrame[32][32] = {
    // --- TOP PADDING ---
    {0,0,0,0,0,0,0,0,0,0,0,0,0,0,0,0,0,0,0,0,0,0,0,0,0,0,0,0,0,0,0,0},
    {0,0,0,0,0,0,0,0,0,0,0,0,0,0,0,0,0,0,0,0,0,0,0,0,0,0,0,0,0,0,0,0},
    {0,0,0,0,0,0,0,0,0,0,0,0,0,0,0,0,0,0,0,0,0,0,0,0,0,0,0,0,0,0,0,0},
    // --- TOP SERIFS ---
    {1,1,1,1,1,1,0,0,0,0,0,0,0,0,0,0,0,0,0,0,0,0,0,0,0,1,1,1,1,1,1,0},
    {0,0,0,1,1,1,1,0,0,0,0,0,0,0,0,0,0,0,0,0,0,0,0,0,1,1,1,0,0,0,0,0},
    {0,0,0,0,1,1,1,1,0,0,0,0,0,0,0,0,0,0,0,0,0,0,0,0,1,1,0,0,0,0,0,0},
    // --- V SHAPE (Thick Left, Thin Right) ---
    {0,0,0,0,0,1,1,1,1,0,0,0,0,0,0,0,0,0,0,0,0,0,1,1,1,0,0,0,0,0,0,0},
    {0,0,0,0,0,1,1,1,1,0,0,0,0,0,0,0,0,0,0,0,0,0,1,1,0,0,0,0,0,0,0,0},
    {0,0,0,0,0,0,1,1,1,1,0,0,0,0,0,0,0,0,0,0,0,1,1,0,0,0,0,0,0,0,0,0},
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    {0,0,0,0,0,0,0,0,0,1,1,1,1,1,0,0,0,1,1,1,0,0,0,0,0,0,0,0,0,0,0,0},
    // --- CENTRAL STEM ---
    {0,0,0,0,0,0,0,0,0,0,1,1,1,1,1,1,1,1,0,0,0,0,0,0,0,0,0,0,0,0,0,0},
    {0,0,0,0,0,0,0,0,0,0,0,1,1,1,1,1,1,0,0,0,0,0,0,0,0,0,0,0,0,0,0,0},
    {0,0,0,0,0,0,0,0,0,0,0,1,1,1,1,1,1,0,0,0,0,0,0,0,0,0,0,0,0,0,0,0},
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    {0,0,0,0,0,0,0,0,0,0,0,1,1,1,1,1,1,0,0,0,0,0,0,0,0,0,0,0,0,0,0,0},
    // --- BOTTOM SERIF ---
    {0,0,0,0,0,0,0,0,1,1,1,1,1,1,1,1,1,1,1,1,0,0,0,0,0,0,0,0,0,0,0,0},
    {0,0,0,0,0,0,0,0,1,1,1,1,1,1,1,1,1,1,1,1,0,0,0,0,0,0,0,0,0,0,0,0},
    // --- BOTTOM PADDING ---
    {0,0,0,0,0,0,0,0,0,0,0,0,0,0,0,0,0,0,0,0,0,0,0,0,0,0,0,0,0,0,0,0},
    {0,0,0,0,0,0,0,0,0,0,0,0,0,0,0,0,0,0,0,0,0,0,0,0,0,0,0,0,0,0,0,0},
    {0,0,0,0,0,0,0,0,0,0,0,0,0,0,0,0,0,0,0,0,0,0,0,0,0,0,0,0,0,0,0,0}
};


// End letter frames


// Start symbol frames



const uint8_t heartFrame[32][32] = {
    {0,0,0,0,0,0,0,0,0,0,0,0,0,0,0,0,0,0,0,0,0,0,0,0,0,0,0,0,0,0,0,0},
    {0,0,0,0,0,0,0,0,0,0,0,0,0,0,0,0,0,0,0,0,0,0,0,0,0,0,0,0,0,0,0,0},
    {0,0,0,0,0,0,0,0,0,0,0,0,0,0,0,0,0,0,0,0,0,0,0,0,0,0,0,0,0,0,0,0},
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    {0,0,0,0,0,0,0,0,0,0,0,0,0,0,0,0,0,0,0,0,0,0,0,0,0,0,0,0,0,0,0,0}
};

// End symbol frames


const uint8_t blank32x32[32][32] = {
    {0,0,0,0,0,0,0,0,0,0,0,0,0,0,0,0,0,0,0,0,0,0,0,0,0,0,0,0,0,0,0,0},
    {0,0,0,0,0,0,0,0,0,0,0,0,0,0,0,0,0,0,0,0,0,0,0,0,0,0,0,0,0,0,0,0},
    {0,0,0,0,0,0,0,0,0,0,0,0,0,0,0,0,0,0,0,0,0,0,0,0,0,0,0,0,0,0,0,0},
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    {0,0,0,0,0,0,0,0,0,0,0,0,0,0,0,0,0,0,0,0,0,0,0,0,0,0,0,0,0,0,0,0}
};


const uint8_t a_s_heartFrame[32][32] = {
    // --- TOP PADDING ---
    {0,0,0,0,0,0,0,0,0,0,0,0,0,0,0,0,0,0,0,0,0,0,0,0,0,0,0,0,0,0,0,0},
    {0,0,0,0,0,0,0,0,0,0,0,0,0,0,0,0,0,0,0,0,0,0,0,0,0,0,0,0,0,0,0,0},
    {0,0,0,0,0,0,0,0,0,0,0,0,0,0,0,0,0,0,0,0,0,0,0,0,0,0,0,0,0,0,0,0},
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    {0,0,0,0,0,0,0,0,0,0,0,0,0,0,0,0,0,0,0,0,0,0,0,0,0,0,0,0,0,0,0,0}
};



const uint8_t corners32x32[32][32] = {
    {1,0,0,0,0,0,0,0,0,0,0,0,0,0,0,0,0,0,0,0,0,0,0,0,0,0,0,0,0,0,0,1},
    {0,0,0,0,0,0,0,0,0,0,0,0,0,0,0,0,0,0,0,0,0,0,0,0,0,0,0,0,0,0,0,0},
    {0,0,0,0,0,0,0,0,0,0,0,0,0,0,0,0,0,0,0,0,0,0,0,0,0,0,0,0,0,0,0,0},
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    {1,0,0,0,0,0,0,0,0,0,0,0,0,0,0,0,0,0,0,0,0,0,0,0,0,0,0,0,0,0,0,1}
};

const uint8_t diagonal32x32[32][32] = {
    {1,0,0,0,0,0,0,0,0,0,0,0,0,0,0,0,0,0,0,0,0,0,0,0,0,0,0,0,0,0,0,0},
    {0,1,0,0,0,0,0,0,0,0,0,0,0,0,0,0,0,0,0,0,0,0,0,0,0,0,0,0,0,0,0,0},
    {0,0,1,0,0,0,0,0,0,0,0,0,0,0,0,0,0,0,0,0,0,0,0,0,0,0,0,0,0,0,0,0},
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    {0,0,0,0,0,0,0,0,0,0,0,0,0,0,0,0,0,0,0,0,0,0,0,0,0,0,0,0,0,0,0,1}
};

const uint8_t partialDiagonal32x32[32][32] = {
    // Rows 0–7: diagonal
    {1,0,0,0,0,0,0,0,0,0,0,0,0,0,0,0,0,0,0,0,0,0,0,0,0,0,0,0,0,0,0,0},
    {0,1,0,0,0,0,0,0,0,0,0,0,0,0,0,0,0,0,0,0,0,0,0,0,0,0,0,0,0,0,0,0},
    {0,0,1,0,0,0,0,0,0,0,0,0,0,0,0,0,0,0,0,0,0,0,0,0,0,0,0,0,0,0,0,0},
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    {0,0,0,0,0,0,0,0,0,0,0,0,0,0,0,0,0,0,0,0,0,0,0,0,0,0,0,0,0,0,0,0}
};

const uint8_t border32x32[32][32] = {
    {1,1,1,1,1,1,1,1,1,1,1,1,1,1,1,1,1,1,1,1,1,1,1,1,1,1,1,1,1,1,1,1},
    {1,0,0,0,0,0,0,0,0,0,0,0,0,0,0,0,0,0,0,0,0,0,0,0,0,0,0,0,0,0,0,1},
    {1,0,0,0,0,0,0,0,0,0,0,0,0,0,0,0,0,0,0,0,0,0,0,0,0,0,0,0,0,0,0,1},
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    {1,1,1,1,1,1,1,1,1,1,1,1,1,1,1,1,1,1,1,1,1,1,1,1,1,1,1,1,1,1,1,1}
};

const uint8_t leftColumn32x32[32][32] = {
    {1,0,0,0,0,0,0,0,0,0,0,0,0,0,0,0,0,0,0,0,0,0,0,0,0,0,0,0,0,0,0,0},
    {1,0,0,0,0,0,0,0,0,0,0,0,0,0,0,0,0,0,0,0,0,0,0,0,0,0,0,0,0,0,0,0},
    {1,0,0,0,0,0,0,0,0,0,0,0,0,0,0,0,0,0,0,0,0,0,0,0,0,0,0,0,0,0,0,0},
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    {1,0,0,0,0,0,0,0,0,0,0,0,0,0,0,0,0,0,0,0,0,0,0,0,0,0,0,0,0,0,0,0}
};

const uint8_t centerColumn32x32[32][32] = {
    {0,0,0,0,0,0,0,0,0,0,0,0,0,0,1,0,0,0,0,0,0,0,0,0,0,0,0,0,0,0,0,0},
    {0,0,0,0,0,0,0,0,0,0,0,0,0,0,1,0,0,0,0,0,0,0,0,0,0,0,0,0,0,0,0,0},
    {0,0,0,0,0,0,0,0,0,0,0,0,0,0,1,0,0,0,0,0,0,0,0,0,0,0,0,0,0,0,0,0},
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    {0,0,0,0,0,0,0,0,0,0,0,0,0,0,1,0,0,0,0,0,0,0,0,0,0,0,0,0,0,0,0,0}
};

const uint8_t fourRandomColumns32x32[32][32] = {
    {0,0,0,1,0,0,0,1,0,0,0,0,0,0,1,0,0,0,0,0,0,0,0,0,1,0,0,0,0,0,0,0},
    {0,0,0,1,0,0,0,1,0,0,0,0,0,0,1,0,0,0,0,0,0,0,0,0,1,0,0,0,0,0,0,0},
    {0,0,0,1,0,0,0,1,0,0,0,0,0,0,1,0,0,0,0,0,0,0,0,0,1,0,0,0,0,0,0,0},
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    {0,0,0,1,0,0,0,1,0,0,0,0,0,0,1,0,0,0,0,0,0,0,0,0,1,0,0,0,0,0,0,0}
};

const uint8_t bottomRightDiagonal8_32x32[32][32] = {
    // Rows 0–23: all zeros
    {0,0,0,0,0,0,0,0,0,0,0,0,0,0,0,0,0,0,0,0,0,0,0,0,0,0,0,0,0,0,0,0}, // 0
    {0,0,0,0,0,0,0,0,0,0,0,0,0,0,0,0,0,0,0,0,0,0,0,0,0,0,0,0,0,0,0,0}, // 1
    {0,0,0,0,0,0,0,0,0,0,0,0,0,0,0,0,0,0,0,0,0,0,0,0,0,0,0,0,0,0,0,0}, // 2
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    {0,0,0,0,0,0,0,0,0,0,0,0,0,0,0,0,0,0,0,0,0,0,0,0,0,0,0,0,0,0,0,1}  // 31
};

const uint8_t fourRandomRows32x32[32][32] = {
    {0,0,0,0,0,0,0,0,0,0,0,0,0,0,0,0,0,0,0,0,0,0,0,0,0,0,0,0,0,0,0,0},
    {0,0,0,0,0,0,0,0,0,0,0,0,0,0,0,0,0,0,0,0,0,0,0,0,0,0,0,0,0,0,0,0},
    {1,1,1,1,1,1,1,1,1,1,1,1,1,1,1,1,1,1,1,1,1,1,1,1,1,1,1,1,1,1,1,1},
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    {0,0,0,0,0,0,0,0,0,0,0,0,0,0,0,0,0,0,0,0,0,0,0,0,0,0,0,0,0,0,0,0}
};

const uint8_t largerleftdiagonal32x32[32][32] = {
    // --- TOP LEFT DIAGONAL STARTS HERE ---
    {1,0,0,0,0,0,0,0,0,0,0,0,0,0,0,0,0,0,0,0,0,0,0,0,0,0,0,0,0,0,0,0}, // 0
    {0,1,0,0,0,0,0,0,0,0,0,0,0,0,0,0,0,0,0,0,0,0,0,0,0,0,0,0,0,0,0,0}, // 1
    {0,0,1,0,0,0,0,0,0,0,0,0,0,0,0,0,0,0,0,0,0,0,0,0,0,0,0,0,0,0,0,0}, // 2
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    {0,0,0,0,0,0,0,0,0,0,0,0,0,0,0,0,0,0,0,0,0,0,0,0,0,0,0,0,0,0,0,0}
};


